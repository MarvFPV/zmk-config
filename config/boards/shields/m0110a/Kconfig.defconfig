## config/boards/shields/m0110a/Kconfig.defconfig
```kconfig
# Copyright (c) 2020 The ZMK Contributors
# SPDX-License-Identifier: MIT

if SHIELD_M0110A

config ZMK_KEYBOARD_NAME
    default "m0110a"

config ZMK_USB 
    default y

endif
```

## config/boards/shields/m0110a/Kconfig.shield
```kconfig
 #
 # Copyright (c) 2020 The ZMK Contributors
 #
 # SPDX-License-Identifier: MIT
 #

config SHIELD_M0110A
    def_bool $(shields_list_contains,m0110a)
```

## config/boards/shields/unififi/Kconfig.shield
```kconfig
# Copyright (c) 2020 The ZMK Contributors
# SPDX-License-Identifier: MIT

config SHIELD_UNIFIFI
   def_bool $(shields_list_contains,unififi)
```
